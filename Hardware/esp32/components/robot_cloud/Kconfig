## Hardware/esp32/components/robot_cloud/Kconfig
```kconfig
menu "DeskEmoji cloud device channel"

    config ROBOT_CLOUD_ENABLE
        bool "Enable the self-hosted console channel"
        default n
        help
            When enabled the device periodically contacts your own server to
            fetch emotion, action, volume and announcement commands issued from
            the console, and reports its firmware version and volume.

    config ROBOT_CLOUD_URL
        string "Server base URL"
        depends on ROBOT_CLOUD_ENABLE
        default ""
        help
            No trailing slash.  Use https://your-domain in production, or
            http://<pc-lan-address>:8787 while testing against a local server.

            Prefer leaving this blank and setting it on the setup page instead:
            the address belongs to the machine running the console, which moves
            whenever it joins another network, and a value baked into the
            firmware would have to be reflashed to follow it.  Whatever is set
            here is only the fallback used when the setup page supplied nothing.

    config ROBOT_CLOUD_KEY
        string "Device key"
        depends on ROBOT_CLOUD_ENABLE
        default ""
        help
            Short code issued once when binding the device in the console.

            Best left blank: enter it on the setup page instead, so the firmware
            image carries no credential at all.  Anything set here is compiled
            into the binary, so an sdkconfig holding a real key must never be
            committed.  As with the URL, this value is only the fallback used
            when the setup page supplied nothing.

    config ROBOT_CLOUD_POLL_INTERVAL_S
        int "Command poll interval (seconds)"
        depends on ROBOT_CLOUD_ENABLE
        default 3
        range 1 60

    config ROBOT_CLOUD_STATUS_INTERVAL_S
        int "Status report interval (seconds)"
        depends on ROBOT_CLOUD_ENABLE
        default 60
        range 10 3600

    config ROBOT_CLOUD_VOICE
        bool "Enable the cloud voice conversation channel"
        depends on ROBOT_CLOUD_ENABLE
        default n
        help
            When enabled the device can record one utterance, send it to the
            console server and play back the spoken answer.  The server runs
            speech recognition, the model call and speech synthesis, so the
            account needs voice credentials configured in the console and the
            device needs a voice role selected there.

            Requires the account to have configured voice credentials and this
            device to have a voice role, otherwise the server answers 409 and
            the robot reports the reason without recording anything.

    config ROBOT_CLOUD_VOICE_MAX_RECORD_MS
        int "Recording ceiling per utterance (milliseconds)"
        depends on ROBOT_CLOUD_VOICE
        default 10000
        range 1000 30000
        help
            Hard stop for one utterance.  A speech that long is unusual, so
            this mostly bounds how much PSRAM the recording buffer reserves.

    config ROBOT_CLOUD_VOICE_SILENCE_MS
        int "Trailing silence that ends an utterance (milliseconds)"
        depends on ROBOT_CLOUD_VOICE
        default 900
        range 300 3000
        help
            How long the robot waits after you stop talking before it sends
            the audio.  Lower feels snappier but clips slow speakers.

    config ROBOT_CLOUD_VOICE_THRESHOLD
        int "Silence threshold (16-bit PCM level)"
        depends on ROBOT_CLOUD_VOICE
        default 700
        range 40 4000
        help
            Frames whose RMS is below this count as silence; after
            ROBOT_CLOUD_VOICE_SILENCE_MS of them the utterance is sent.  Raise it
            in a noisy room, lower it if the robot stops before you finish.

            This number is only meaningful next to the capture gain, because it
            is an absolute level: change ROBOT_MIC_SHIFT and it has to be moved
            by the same factor.  It used to sit at 320, chosen while the gain
            was 16x too high (see ROBOT_MIC_SHIFT); once that was corrected,
            ordinary speech reported an RMS of 1500-2300 while the threshold
            stayed at roughly a fifth of it, so room noise tripped it constantly
            and the utterance always ran to the recording ceiling.  Measured on
            the DeskEmoji board with the gain corrected: 700 ends the utterance
            about a second after you stop talking.

    config ROBOT_CLOUD_VOICE_BARGE_IN
        bool "Let the wake word interrupt a reply"
        depends on ROBOT_CLOUD_VOICE
        default n
        help
            With this on the microphone keeps running while the robot speaks, so
            saying the wake word again cuts the reply short and starts listening
            for a new question inside the same conversation.

            The price is self-listening: one microphone and no echo cancellation
            means the robot can hear its own voice, so a wake phrase inside its
            own answer could interrupt it.

            Off by default.  Measured on the DeskEmoji board (2026-10-15): while
            the reply plays, the microphone sees 9k-26k peaks from the speaker
            alone, the wake phrase is buried in that, and the engine detected
            nothing at all across a whole reply.  Without AEC this cannot be made
            reliable, so the button stays the interrupt: a short BOOT press cuts
            the reply (and ends the conversation).  Turning this on only helps if
            an echo canceller is added in front of the wake engine.

    config ROBOT_CLOUD_VOICE_FOLLOW_UP
        bool "Keep listening after each reply (continuous conversation)"
        depends on ROBOT_CLOUD_VOICE
        default y
        help
            With this on, saying the wake word once opens a conversation: after
            every reply the robot listens again for the next question instead of
            returning to the wake word.  The conversation ends when the window
            below expires without a word, when a turn fails, or when a button
            cancels the turn.

            Turning it off restores one-wake-one-turn, and also restores
            recording (and uploading) a silent turn instead of ending it early.

    config ROBOT_CLOUD_VOICE_FOLLOW_UP_MS
        int "Wait for speech before ending a turn (ms)"
        depends on ROBOT_CLOUD_VOICE_FOLLOW_UP
        default 4000
        range 1000 15000
        help
            How long the robot waits for speech before deciding nobody is going
            to talk.  It bounds both the wait after the wake word and the gap
            between two questions in a conversation.  Lower feels snappier but
            cuts off people who think before they speak.

endmenu
```

## Hardware/esp32/main/Kconfig.projbuild
```kconfig
menu "DeskEmoji robot"

config ROBOT_ENABLE_ESP_SR
    bool "Enable offline ESP-SR wake word"
    default y


config ROBOT_ENABLE_GESTURE
    bool "Enable PAJ7620U2 gestures"
    default y

config ROBOT_ENABLE_RANDOM_ANIMATION
    bool "Enable idle random animation"
    default y

config ROBOT_ENABLE_SERVO
    bool "Enable dual servos"
    default y


config ROBOT_SERVO_X_PIN
    int "Horizontal servo GPIO"
    range 0 48
    default 11
    help
        Signal pin of the horizontal (pan) servo.  Default 11 matches the
        DeskEmoji board this firmware was ported from; change it when a board
        variant wires its servos differently.

config ROBOT_SERVO_Y_PIN
    int "Vertical servo GPIO"
    range 0 48
    default 12
    help
        Signal pin of the vertical (tilt) servo.  Default 12, same caveat as
        the horizontal pin.

config ROBOT_SERVO_SELFTEST
    bool "Sweep both servos once at boot (bring-up aid)"
    default n
    help
        Runs before Wi-Fi comes up and sweeps the horizontal then the vertical
        servo from limit to limit, logging each phase.  Useful to tell a silent
        servo apart from a firmware or connection problem: if nothing moves here,
        the fault is on the hardware side (power, wiring, servo).  Adds a few
        seconds to boot, so keep it off for normal use.

config ROBOT_MIC_RIGHT_CHANNEL
    bool "I2S microphone drives the RIGHT channel"
    default n
    help
        The L/R pin of the microphone selects which half of the I2S frame it
        drives: tied to GND it drives the left half, tied to VDD the right one.
        This firmware reads the left half, which matches the DeskEmoji board
        and the schematic.  Reading the half the microphone does not drive
        yields nothing but silence - which looks exactly like a dead microphone
        except that the captured level is precisely zero everywhere.

        Enable this only if the microphone is wired the other way round.
        Check pin 6 (L/R) of the microphone against GND with a multimeter
        first: continuity to GND means the default is already correct.

config ROBOT_MIC_SAMPLE_RATE
    int "Microphone sample rate (Hz)"
    range 8000 48000
    default 16000
    help
        Rate of the capture channel only.  The speaker keeps its own fixed rate
        because the server sends 16 kHz speech back and both ends have to agree;
        capture and playback are separate I2S controllers, so this one can move
        on its own.

        The board this firmware was ported from runs its I2S microphone at
        24000.  16000 is also inside the microphone's supported clock range and
        is what the cloud speech service expects to be told, so the default
        stays there.  Change it only when investigating capture problems, and
        remember the device reports this value to the server in the
        X-Sample-Rate header, so the two cannot drift apart.

config ROBOT_MIC_SHIFT
    int "Microphone 32-bit to 16-bit right shift (capture gain)"
    range 8 16
    default 16
    help
        The I2S peripheral hands over one 32-bit slot per sample while the
        microphone drives only its top bits, so the raw value is shifted right
        before it is clamped into 16 bits.  This shift is the capture gain, and
        it is the one number that decides whether the audio is usable:

          too small - ordinary speech lands past full scale, the clamp flattens
                      it into a square wave, and recognition hears nothing while
                      the level still looks healthy: the peak sits pinned at
                      32768, the RMS is over half of full scale, and nearly every
                      sample counts as "voiced"
          too large - the audio is quiet and recognition struggles the other way

        This microphone puts its 24 bits in the top of the 32-bit slot, so 16 is
        the value that maps its full range onto the full 16-bit range.  The
        firmware this board was ported from uses 12 and still works, because it
        feeds the microphone through an audio front end with automatic gain
        control; this firmware sends the raw capture to the server and so has to
        get the gain right here.

        Measured on the DeskEmoji board at 24000 Hz: with 12, speech reports a
        peak of 32768, an RMS of 18552 and 14-16% of samples clamped.  Both the
        bit alignment and that measurement point at 16, so it is the default.
        Only lower it if the captured audio turns out too quiet.


config ROBOT_STA_CONNECT_TIMEOUT_SECONDS
    int "Saved Wi-Fi connection timeout"
    range 10 180
    default 60

endmenu
```

## Hardware/esp32/sdkconfig.defaults
```kconfig
CONFIG_IDF_TARGET="esp32s3"
CONFIG_ESPTOOLPY_FLASHSIZE_16MB=y
CONFIG_SPIRAM=y
CONFIG_SPIRAM_MODE_OCT=y
CONFIG_SPIRAM_SPEED_80M=y
CONFIG_SPIRAM_USE_MALLOC=y
CONFIG_PARTITION_TABLE_CUSTOM=y
CONFIG_PARTITION_TABLE_CUSTOM_FILENAME="partitions.csv"
CONFIG_ESP_MAIN_TASK_STACK_SIZE=8192
CONFIG_MBEDTLS_CERTIFICATE_BUNDLE=y
CONFIG_MBEDTLS_CERTIFICATE_BUNDLE_DEFAULT_FULL=y
CONFIG_MBEDTLS_EXTERNAL_MEM_ALLOC=y
CONFIG_MBEDTLS_HARDWARE_AES=y
CONFIG_MBEDTLS_AES_USE_INTERRUPT=y
CONFIG_SPIRAM_MALLOC_ALWAYSINTERNAL=1024
CONFIG_SPIRAM_MALLOC_RESERVE_INTERNAL=65536
CONFIG_ESP_WIFI_SOFTAP_SUPPORT=y
CONFIG_LWIP_DNS_SUPPORT_MDNS_QUERIES=y
CONFIG_SPIFFS_USE_MAGIC=y
CONFIG_SPIFFS_USE_MAGIC_LENGTH=y
CONFIG_SR_MN_CN_MULTINET7_QUANT=y
CONFIG_MODEL_IN_FLASH=y
CONFIG_ROBOT_ENABLE_ESP_SR=y
CONFIG_ROBOT_ENABLE_GESTURE=y
CONFIG_ROBOT_ENABLE_RANDOM_ANIMATION=y
CONFIG_ROBOT_ENABLE_SERVO=y
CONFIG_ESP_SYSTEM_PANIC_REBOOT_DELAY_SECONDS=3

# ---- 公网托管下的 TCP 吞吐（2026-10-15 T039 追加）----
# 设备与云托管之间的 RTT 实测 ~111 ms，而 lwIP 默认收发窗口只有 5760 字节：
# 5760 B / 0.111 s ≈ 52 KB/s，扣除 TLS 与解析开销后实测只有 18 KB/s，
# 而音频恒定要 32 KB/s（录音上传同样受限：320 KB 要传 18 秒）。
# 放大窗口/发送缓冲是标准做法；配合 SPIRAM 分配避免挤占内部 RAM。
CONFIG_LWIP_TCP_WND_DEFAULT=20000
CONFIG_LWIP_TCP_SND_BUF_DEFAULT=20000
CONFIG_LWIP_TCP_RECVMBOX_SIZE=16
CONFIG_SPIRAM_TRY_ALLOCATE_WIFI_LWIP=y
```
